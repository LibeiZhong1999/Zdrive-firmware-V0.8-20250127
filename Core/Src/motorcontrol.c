#include "motorcontrol.h"


const float one_div_sq_three=0.57735026919;
const float sq_three=1.7320508075688;
const uint32_t ARR=8400;
const float cycle=0.00016,one_div_cycle=6250,Ld=0.000042,Lq=0.000042,R=0.08,pole_pair=7,angle_offset=8670;//cycle=160us
const float pi=3.141592653589793238462643;
const float rad_to_deg=57.295779,pulse_to_rad=0.00306796157577128245943617517898;
const float k_tor=0.025,one_div_k_tor=40,J_iner=2e-6,i_vec_mod_lim=45,vel_ref_lim=3000*2*pi/60;

float ia,ib,ic,ua,ub,uc,tem,dc_bus=10,ia_carli=0,ib_carli=0,ic_carli=0,theta_e=0,scalefactor;
float sintest,costest,sintest1,costest1;
uint32_t ia_u32,ib_u32,ic_u32,ia_carli_u32,ib_carli_u32,ic_carli_u32;
float id_ref,id,id_pre=0,kp_d,ki_d,integ_d=0,ud,ud_mod;
float iq_ref,iq,iq_pre=0,kp_q,ki_q,integ_q=0,uq,uq_mod;
float theta_m=-1,theta_m_pre=-1,vel_m;
float vel_ref,kp_vel,ki_vel,integ_vel=0;
float pos_ref,kp_pos,integ_pos=0;
float vel_fil,vel_fil_pre=-1;
int16_t encPositionA;

const float iq_anticog[2048]={-0.277744,-0.110188,-0.004188,-0.149316,-0.315649,-0.070767,-0.082440,-0.009973,-0.181903,-0.119330,-0.107592,-0.138882,-0.128515,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0.093220,0.032524};

/*
*alpha beta is standized to (0,1)
**corresponding to the three phase voltage vector coordinate system standized by Vdc
*return value (tA,tB,tC,status) 
**tA is Duty cycle of axis A in [0,1],corresponding the time of high volatge
**status is bool type,identifies whether tA/tB/tC is effective
*/
struct tri_vector SVPWM(float alpha,float beta)
{
	struct tri_vector ans_vector;
	uint8_t region_num;
	float  tA,tB,tC;
	
	// identify vector region
	if(beta>=0)
	{
		if(alpha>=0)
		{
			if((alpha-one_div_sq_three*beta)>0)
				region_num=1;
			else
				region_num=2;
		}
		else
		{
			if((alpha+one_div_sq_three*beta)<=0)
				region_num=3;
			else
				region_num=2;
		}
	}
	else
	{
		if(alpha>=0)
		{
			if((alpha+one_div_sq_three*beta)>0)
				region_num=6;
			else
				region_num=5;
		}
		else
		{
			if((alpha-one_div_sq_three*beta)<0)
				region_num=4;
			else
				region_num=5;
		}
	}
	
	//calculate phase A B C duty cycle
	switch (region_num)
	{
		case 1:
		{
			float t1=alpha-one_div_sq_three*beta;
			float t2=2*one_div_sq_three*beta;
			tC=(1-t1-t2)*0.5f;
			tB=tC+t2;
			tA=tB+t1;
		}break;
		
		case 2:
		{
			float t2=alpha+one_div_sq_three*beta;
			float t3=-alpha+one_div_sq_three*beta;
			tC=(1-t2-t3)*0.5f;
			tA=tC+t2;
			tB=tA+t3;
		}break;
		
		case 3:
		{
			float t3=2*one_div_sq_three*beta;
			float t4=-alpha-one_div_sq_three*beta;
			tA=(1-t3-t4)*0.5f;
			tC=tA+t4;
			tB=tC+t3;
		}break;
		
		case 4:
		{
			float t4=-alpha+one_div_sq_three*beta;
			float t5=-2*one_div_sq_three*beta;
			tA=(1-t4-t5)*0.5f;
			tB=tA+t4;
			tC=tB+t5;
		}break;
		
		case 5:
		{
			float t5=-alpha-one_div_sq_three*beta;
			float t6=alpha-one_div_sq_three*beta;
			tB=(1-t5-t6)*0.5f;
			tA=tB+t6;
			tC=tA+t5;
		}break;
		
		case 6:
		{
			float t6=-2*one_div_sq_three*beta;
			float t1=alpha+one_div_sq_three*beta;
			tB=(1-t6-t1)*0.5f;
			tC=tB+t6;
			tA=tC+t1;
		}break;
	}
	
	ans_vector.fir=tA;
	ans_vector.sec=tB;
	ans_vector.thi=tC;
	ans_vector.sta=((tA>=0)&&(tA<=1)&&(tB>=0)&&(tB<=1)&&(tC>=0)&&(tC<=1));
	return ans_vector;
}

/*
*transfer 3 phase duty cycle(tA,tB,tC) to PWM CCR
* tA/B/C is in [0,1],corresponding the time of high volatge
*/
void apply_pwm(struct tri_vector volt_abc_v)
{
	if(volt_abc_v.sta)
	{
		__HAL_TIM_SetCompare(&htim1,	TIM_CHANNEL_3,(uint32_t)(ARR*(1-volt_abc_v.fir)));//U
		__HAL_TIM_SetCompare(&htim1,	TIM_CHANNEL_2,(uint32_t)(ARR*(1-volt_abc_v.sec)));//V
		__HAL_TIM_SetCompare(&htim1,	TIM_CHANNEL_1,(uint32_t)(ARR*(1-volt_abc_v.thi)));//W
	}
	else
	{
		__HAL_TIM_SetCompare(&htim1,	TIM_CHANNEL_3,(uint32_t)(ARR*0.5));//U
		__HAL_TIM_SetCompare(&htim1,	TIM_CHANNEL_2,(uint32_t)(ARR*0.5));//V
		__HAL_TIM_SetCompare(&htim1,	TIM_CHANNEL_1,(uint32_t)(ARR*0.5));//W
	}
}


/*
	*transfer current vector from abc coordinate system to dq coordinate system
	*cur_abc_v=(ia,ib,ic,status)   theta_tf is the angle at which the d-axis is ahead of the a-axis  !rad
	*return para=(id,iq,default,status)
	*After transformation, the vector modulus does not change
	*In the n-phase coordinate system, if each axis component is sinusoidal and the amplitude is A, 
	the phases are 2 pi/n rad apart from each other. 
	Then the composite vector modulus is nA/2 and the angle is equal to the sinusoidal phase of the prime phase component
	*so if current vector modulus is S,then the amplitude of axis component of abc is 2S/3, dq and alpha-beta is S
*/
struct tri_vector Clark_Park_Tf(struct tri_vector cur_abc_v,float theta_tf)
{
	struct tri_vector cur_dq_v;
	if(cur_abc_v.sta)
	{
		float sin_tf,cos_tf,sin_tf_plus,sin_tf_sub,cos_tf_plus,cos_tf_sub;
		sin_tf=arm_sin_f32(theta_tf);
		cos_tf=arm_cos_f32(theta_tf);
		
		sintest=arm_sin_f32(theta_tf);
		costest=arm_cos_f32(theta_tf);
		
		sin_tf_plus=-0.5*sin_tf+0.5*sq_three*cos_tf;
		cos_tf_plus=-0.5*cos_tf-0.5*sq_three*sin_tf;
		sin_tf_sub=-0.5*sin_tf-0.5*sq_three*cos_tf;
		cos_tf_sub=-0.5*cos_tf+0.5*sq_three*sin_tf;
		cur_dq_v.fir=cur_abc_v.fir*cos_tf+cur_abc_v.sec*cos_tf_sub+cur_abc_v.thi*cos_tf_plus;
		cur_dq_v.sec=-cur_abc_v.fir*sin_tf-cur_abc_v.sec*sin_tf_sub-cur_abc_v.thi*sin_tf_plus;
		cur_dq_v.sta=true;
		return cur_dq_v;
	}
	else
	{
		cur_dq_v.sta=false;
		return cur_dq_v;
	}
}

/*
	*transfer voltage vector from dq coordinate system to alpha-beta coordinate system
	*volt_dq_v=(vd,vq,default,status)   theta_tf is the angle at which the d-axis is ahead of the a-axis  !rad
	*return para=(v_alpha,v_beta,default,status)
	*After transformation, the vector modulus does not change
*/
struct tri_vector Inv_Park_Tf(struct tri_vector volt_dq_v,float theta_tf)
{
	struct tri_vector volt_albe_v;
	if(volt_dq_v.sta)
	{
		float sin_tf,cos_tf;
		sin_tf=arm_sin_f32(theta_tf);
		cos_tf=arm_cos_f32(theta_tf);
		volt_albe_v.fir=volt_dq_v.fir*cos_tf-volt_dq_v.sec*sin_tf;
		volt_albe_v.sec=volt_dq_v.fir*sin_tf+volt_dq_v.sec*cos_tf;
		volt_albe_v.sta=true;
		return volt_albe_v;
	}
	else
	{
		volt_albe_v.sta=false;
		return volt_albe_v;
	}
}

/*
	current loop
	before using this function,shoule initialize id_ref,iq_ref,kp_d,ki_d,kp_q,ki_q;
*/
void current_loop()
{
	//cal theta_e
	theta_e=(((float)encPositionA)-angle_offset)*pulse_to_rad*pole_pair;
	
//	theta_e=0;
	
//			theta_e+=0.005;
	
	while(theta_e<0)
		theta_e+=2*pi;
	while(theta_e>2*pi)
		theta_e-=2*pi;
//	

	
	struct tri_vector Iabc,Idq,Udq,Ualbe,Uabc;
	Iabc.fir=ia,Iabc.sec=ib,Iabc.thi=ic,Iabc.sta=true;
	Idq=Clark_Park_Tf(Iabc,theta_e);
	id=Idq.fir;
	iq=Idq.sec;
	
	//id iq filter
	id=0.8*id+0.2*(id_pre);
	iq=0.8*iq+0.2*(iq_pre);
	id_pre=id;
	iq_pre=iq;
	
	float del_id=id_ref-id;
	integ_d+=del_id;
	ud=kp_d*del_id+ki_d*integ_d*cycle;
	
	float del_iq=iq_ref-iq;
	integ_q+=del_iq*cycle;
	uq=kp_q*del_iq+ki_q*integ_q;
	
	//voltage Standardization
	float mod_to_V=dc_bus;
	float V_to_mod=1/dc_bus;
	ud_mod=ud*V_to_mod;
	uq_mod=uq*V_to_mod;
	
	//voltage limitation  0.8*sqrt(3)/2
	float volt_vec_mod,sqrt_volt_vec_mod;
	volt_vec_mod=ud_mod*ud_mod+uq_mod*uq_mod;
	arm_sqrt_f32(volt_vec_mod,&sqrt_volt_vec_mod);
	scalefactor=one_div_sq_three*1.5*0.8/sqrt_volt_vec_mod;
	if(scalefactor<1)
	{
		ud_mod*=scalefactor;
		uq_mod*=scalefactor;
	}
	
	Udq.fir=ud_mod;
	Udq.sec=uq_mod;
	Udq.sta=true;
	Ualbe=Inv_Park_Tf(Udq,theta_e);
	Uabc=SVPWM(Ualbe.fir,Ualbe.sec);
	apply_pwm(Uabc);
}

void speed_loop()
{
	float del_vel_m=vel_ref-vel_fil;
	integ_vel+=del_vel_m*cycle*16;
	iq_ref=(kp_vel*del_vel_m+ki_vel*integ_vel)*J_iner*one_div_k_tor;
//	iq_ref+=iq_anticog[encPositionA];
	if(iq_ref>i_vec_mod_lim*0.6)
		iq_ref=i_vec_mod_lim*0.6;
	if(iq_ref<-i_vec_mod_lim*0.6)
		iq_ref=-i_vec_mod_lim*0.6;
	
	id_ref=0;
}

void pos_loop()
{
	float del_pos=pos_ref-vel_m*cycle*16;//unit rad/T
	integ_pos+=kp_pos*del_pos*cycle*16;	//unit rad/T
	vel_ref=integ_pos*one_div_cycle/16;								//unit rad/s
	if(vel_ref>vel_ref_lim)
		vel_ref=vel_ref_lim;
	if(vel_ref<-vel_ref_lim)
		vel_ref=-vel_ref_lim;
}

